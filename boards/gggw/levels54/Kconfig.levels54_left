## boards/gggw/levels54/Kconfig.levels54_left
```kconfig
# Copyright (c) 2025 Vincent Franco
# SPDX-License-Identifier: MIT

config BOARD_LEVELS54_LEFT
  select SOC_NRF52840_QIAA
  imply RETAINED_MEM
  imply RETENTION
  imply RETINTION_BOOT_MODE
```

## boards/gggw/levels54/Kconfig.levels54_right
```kconfig
# Copyright (c) 2025 Vincent Franco
# SPDX-License-Identifier: MIT

config BOARD_LEVELS54_RIGHT
  select SOC_NRF52840_QIAA
  imply RETAINED_MEM
  imply RETENTION
  imply RETINTION_BOOT_MODE
```

## boards/gggw/levels54/board.yml
```yaml
boards:
  - name: levels54_left
    vendor: gggw
    socs:
      - name: nrf52840
  - name: levels54_right
    vendor: gggw
    socs:
      - name: nrf52840
```
