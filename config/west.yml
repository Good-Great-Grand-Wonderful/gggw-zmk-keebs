## config/west.yml
```yaml
manifest:
  defaults:
    revision: main
  remotes:
    - name: zmkfirmware
      url-base: https://github.com/zmkfirmware
    - name: efogdev
      url-base: https://github.com/efogdev
    - name: badjeff
      url-base: https://github.com/badjeff
    - name: caksoylar
      url-base: https://github.com/caksoylar
  projects:
    - name: zmk
      remote: zmkfirmware
      revision: ff09f2d0c9f13a868c8f71d71d9348ade438e4b6
      import: app/west.yml
    - name: zmk-pmw3610-driver-badjeff
      remote: badjeff
      repo-path: zmk-pmw3610-driver
      revision: zmk-0.4
      path: modules/zmk-pmw3610-driver-badjeff
    - name: zmk-pmw3610-driver-efog
      remote: efogdev
      repo-path: zmk-pmw3610-driver
      revision: zephyr-4.1
      path: modules/zmk-pmw3610-driver-efog
    - name: zmk-report-rate-limit
      remote: efogdev
      revision: 7f55412be4f85069b67d5984ab7c71aa2a6cf34f
    - name: zmk-input-processor-xyz
      remote: badjeff
      revision: main
    - name: zmk-rgbled-widget
      remote: caksoylar
      revision: 9cef5af88c26e4b86a2a448160055dc740c14d6f
  self:
    path: config
```
